## meta-company/conf/distro/companydistro.conf
```bitbake
DISTRO = "companydistro"
DISTRO_NAME = "Company Distro"

DISTRO_VERSION = "0.1"

PACKAGE_CLASSES = "package_ipk"

INIT_MANAGER = "systemd"

DISTRO_FEATURES += "systemd virtualization seccomp"

VIRTUAL-RUNTIME_init_manager = "systemd"

EXTRA_IMAGE_FEATURES += "allow-empty-password empty-root-password"

USER_CLASSES ?= "buildstats"

PATCHRESOLVE = "noop"

INHERIT += "rm_work"

LICENSE_FLAGS_ACCEPTED = "*"
```

## meta-company/conf/layer.conf
```bitbake
BBPATH .= ":${LAYERDIR}"

BBFILES += "${LAYERDIR}/recipes-*/*/*.bb"

BBFILE_COLLECTIONS += "company"

BBFILE_PATTERN_company = "^${LAYERDIR}/"

BBFILE_PRIORITY_company = "6"

LAYERSERIES_COMPAT_company = "scarthgap"
```

## meta-company/conf/machine/company-qemuarm64.conf
```bitbake
KMACHINE = "qemuarm64"

require conf/machine/qemuarm64.conf

MACHINEOVERRIDES =. "qemuarm64:"
KMACHINE = "qemuarm64"

PREFERRED_PROVIDER_virtual/bootloader = "u-boot"
UBOOT_MACHINE = "qemu_arm64_defconfig"

SERIAL_CONSOLES = "115200;ttyAMA0"
```

## meta-company/wic/company-image.wks
```
# Boot partition A
part /boot --source bootimg-partition --ondisk sda --fstype=vfat --label bootA --align 4096 --size 128 --active --use-uuid

# Boot partition B
part --source bootimg-partition --ondisk sda --fstype=vfat --label bootB --align 4096 --size 128 --use-uuid

# Root filesystem A
part / --source rootfs --ondisk sda --fstype=ext4 --label rootfsA --align 4096 --size 768 --use-uuid

# Root filesystem B
part --ondisk sda --fstype=ext4 --label rootfsB --align 4096 --size 768 --use-uuid

# Persistent application/device data
part /data --ondisk sda --fstype=ext4 --label data --align 4096 --size 512 --use-uuid

# RAUC state/status storage
part /var/lib/rauc --ondisk sda --fstype=ext4 --label rauc-state --align 4096 --size 64 --use-uuid

# QEMU uses virtio, so Linux sees the disk as /dev/vda.
# Active slot starts as A: bootA + rootfsA.
bootloader --ptable gpt --append="root=/dev/vda3 rootwait rootfstype=ext4 console=ttyAMA0,115200"
```
